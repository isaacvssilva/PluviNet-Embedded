## main/Kconfig.projbuild
```kconfig
menu "Configurações MQTT / FIWARE (Estação)"

    config MQTT_BROKER_HOST
        string "MQTT Broker Host"
        default "SEU_HOST_AQUI"

    config MQTT_BROKER_PORT
        int "MQTT Broker Port"
        default PORTA

    config FIWARE_API_KEY
        string "FIWARE API Key"
        default "COLOQUE_SUA_CHAVE_AQUI"

    config FIWARE_DEVICE_ID
        string "FIWARE Device ID"
        default "NOME_DO_DISPOSITIVO"

endmenu
```
